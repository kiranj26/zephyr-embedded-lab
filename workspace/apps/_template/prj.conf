## CMakeLists.txt
```
cmake_minimum_required(VERSION 3.20.0)

find_package(Zephyr REQUIRED HINTS $ENV{ZEPHYR_BASE})
project(app_template)

FILE(GLOB app_sources src/*.c)
target_sources(app PRIVATE ${app_sources})
```

## prj.conf
```kconfig
# Kconfig for this app. Common starters:
# CONFIG_GPIO=y
# CONFIG_LOG=y
# CONFIG_LOG_DEFAULT_LEVEL=3
```

## boards/esp32s3_devkitc.overlay
```dts
/* Devicetree overlay for ESP32-S3-DevKitC-1 (N16R8).
 * Safe pins: see docs/01-hardware.md. NEVER use GPIO 26-37, 19/20, 43/44.
 */
/ {
};
```

## src/main.c
```c
#include <zephyr/kernel.h>
#include <zephyr/logging/log.h>

LOG_MODULE_REGISTER(app, LOG_LEVEL_INF);

int main(void)
{
	printk("App template running\r\n");

	while (1) {
		/* TODO: your code */
		k_msleep(1000);
	}

	return 0;
}
```

## CMakeLists.txt
```
cmake_minimum_required(VERSION 3.20.0)

# Lesson 6: register your out-of-tree driver module BEFORE find_package(Zephyr).
# Step 1: cp -R ../../modules/_templates/sensor_driver ../../modules/mcp9808_mine  (rename inside!)
# set(ZEPHYR_EXTRA_MODULES "${CMAKE_SOURCE_DIR}/../../modules/mcp9808_mine")

find_package(Zephyr REQUIRED HINTS $ENV{ZEPHYR_BASE})
project(my_driver)

target_sources(app PRIVATE src/main.c)
```

## prj.conf
```kconfig
CONFIG_GPIO=y
CONFIG_LOG=y
CONFIG_LOG_DEFAULT_LEVEL=4
# TODO: CONFIG_I2C=y, CONFIG_SENSOR=y, and your driver's symbol (e.g. CONFIG_MY_SENSOR=y)
```

## boards/esp32s3_devkitc.overlay
```dts
/* Lesson 6 — MCP9808 on I2C0. Wiring: SDA GPIO15, SCL GPIO16, VDD 3V3, GND, A0-A2 -> GND (addr 0x18)
 * TODO:
 *   1. &pinctrl { i2c0_custom_pins: ... { group1 { pinmux = <I2C0_SDA_GPIO15>, <I2C0_SCL_GPIO16>;
 *        bias-pull-up; drive-open-drain; output-high; }; }; };
 *   2. &i2c0 { pinctrl-0 = <&i2c0_custom_pins>; status = "okay";
 *        my_sensor_18: <name>@18 { compatible = "<must match your binding>"; reg = <0x18>; ... }; };
 *   3. alias: my-sensor = &my_sensor_18;
 */
/ {
};
```

## src/main.c
```c
/*
 * Lesson 6 — Device drivers
 * Part A (demo): understand course/workspace/modules/button — trace one call from
 *   btn_api->get() in the app down to gpio_pin_get_dt() in the driver.
 * Part B (challenge): your own MCP9808 driver module (start from modules/_templates/sensor_driver)
 *   and the workshop: github.com/ShawnHymel/workshop-zephyr-device-driver
 *
 * App TODOs:
 *   1. const struct device *const sensor = DEVICE_DT_GET(DT_ALIAS(my_sensor));
 *   2. device_is_ready(sensor)
 *   3. loop: sensor_sample_fetch(); sensor_channel_get(SENSOR_CHAN_AMBIENT_TEMP, &val);
 *            printk("Temperature: %d.%06d\n", val.val1, val.val2);
 */
#include <zephyr/kernel.h>
/* #include <zephyr/drivers/sensor.h> */

int main(void)
{
	printk("Lesson 6 starter\r\n");
	while (1) {
		k_msleep(1000);
	}
	return 0;
}
```

## workspace/boards/custom/s3_n16r8/board.yml
```yaml
board:
  name: s3_n16r8
  full_name: ESP32-S3-DevKitC-1 N16R8 (my lab board)
  vendor: custom
  socs:
  - name: esp32s3
```

## workspace/modules/_templates/sensor_driver/drivers/my_sensor/Kconfig
```kconfig
config MY_SENSOR
	bool "My I2C temperature sensor"
	default n
	depends on I2C
	depends on SENSOR
	help
	  Template driver. Rename for your part (e.g. MCP9808_MINE).
```

## workspace/modules/greeting/Kconfig
```kconfig
config GREETING
	bool "Greeting library"
	default n
	depends on PRINTK
	help
	  Adds greeting_say(), which prints a message. Lesson 3 practice module.

config GREETING_REPEAT
	int "How many times to greet"
	default 1
	range 1 10
	depends on GREETING
```

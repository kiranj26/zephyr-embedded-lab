## CMakeLists.txt
```
cmake_minimum_required(VERSION 3.20.0)

find_package(Zephyr REQUIRED HINTS $ENV{ZEPHYR_BASE})
project(http_client)

FILE(GLOB app_sources src/*.c)
target_sources(app PRIVATE ${app_sources})
```

## prj.conf
```kconfig
CONFIG_LOG_MODE_MINIMAL=y
CONFIG_MAIN_STACK_SIZE=4096
CONFIG_WIFI=y
CONFIG_NETWORKING=y
CONFIG_NET_IPV4=y
CONFIG_NET_IPV6=y
CONFIG_NET_TCP=y
CONFIG_NET_SOCKETS=y
CONFIG_NET_DHCPV4=y
CONFIG_DNS_RESOLVER=y
CONFIG_NET_CONFIG_INIT_TIMEOUT=30
CONFIG_NET_LOG=y
CONFIG_NET_L2_ETHERNET=y
# Challenge: use Zephyr's HTTP client subsystem instead of hand-built requests
# CONFIG_HTTP_CLIENT=y
```

## src/main.c
```c
/*
 * Lesson 11 — Wi-Fi + HTTP GET
 *   1. cp src/secrets.h.example src/secrets.h  (fill it in; it's git-ignored)
 *   2. wifi_init(); wifi_connect(WIFI_SSID, WIFI_PSK); wifi_wait_for_ip_addr();
 *   3. DNS: zsock_getaddrinfo("example.com", "80", &hints, &res)   (hints: AF_INET, SOCK_STREAM)
 *   4. zsock_socket / zsock_connect / zsock_send("GET / HTTP/1.1\r\nHost: example.com\r\n\r\n")
 *   5. zsock_recv loop until 0; print; zsock_close; zsock_freeaddrinfo
 *   Challenge: replace 4–5 with http_client_req() (CONFIG_HTTP_CLIENT) and a response callback.
 */
#include <zephyr/kernel.h>
#include <zephyr/net/socket.h>
#include "wifi.h"

#if __has_include("secrets.h")
#include "secrets.h"
#else
#warning "src/secrets.h missing - copy secrets.h.example"
#define WIFI_SSID ""
#define WIFI_PSK  ""
#endif

int main(void)
{
	printk("Lesson 11 starter (SSID configured: %s)\r\n", WIFI_SSID[0] ? "yes" : "no");
	/* TODO */
	return 0;
}
```

## src/wifi.c
```c
/*
 * Lesson 11 — write the Wi-Fi helper yourself.
 *   - two net_mgmt_event_callback structs (Wi-Fi connect/disconnect, IPv4 address added)
 *   - two semaphores (K_SEM_DEFINE(sem, 0, 1)) given from the callbacks
 *   - wifi_connect(): fill struct wifi_connect_req_params (ssid, psk, WIFI_SECURITY_TYPE_PSK,
 *       WIFI_FREQ_BAND_UNKNOWN, WIFI_CHANNEL_ANY, WIFI_MFP_OPTIONAL) -> net_mgmt(NET_REQUEST_WIFI_CONNECT, ...)
 *       then k_sem_take(&sem_wifi, K_FOREVER)
 *   - wifi_wait_for_ip_addr(): wait on sem_ipv4, then print status (NET_REQUEST_WIFI_IFACE_STATUS)
 * Improvement over the course: return errors, use timeouts instead of K_FOREVER, reconnect on disconnect.
 */
#include <errno.h>
#include <zephyr/kernel.h>
#include <zephyr/net/wifi_mgmt.h>
#include "wifi.h"

void wifi_init(void) { /* TODO */ }
int wifi_connect(const char *ssid, const char *psk) { ARG_UNUSED(ssid); ARG_UNUSED(psk); return -ENOSYS; }
void wifi_wait_for_ip_addr(void) { /* TODO */ }
int wifi_disconnect(void) { return -ENOSYS; }
```

## src/wifi.h
```c
#ifndef WIFI_H_
#define WIFI_H_

void wifi_init(void);
int wifi_connect(const char *ssid, const char *psk);
void wifi_wait_for_ip_addr(void);
int wifi_disconnect(void);

#endif /* WIFI_H_ */
```

/* Copy of course/workspace/apps/05_demo_adc, adapted for my wiring:
 * potentiometer wiper on GPIO6 = ADC1 channel 5 (the course uses GPIO1 = channel 0).
 * Zephyr names ADC1 "adc0" (Zephyr counts from 0, Espressif from 1).
 */
/ {
    aliases {
        my-adc = &adc0;
        my-adc-channel = &adc0_ch5;
    };
};

// ADC1 (adc0) channel 5 is connected to GPIO6
&adc0 {
    status = "okay";
    #address-cells = <1>;
    #size-cells = <0>;

    adc0_ch5: channel@5 {
        reg = <5>;
        zephyr,gain = "ADC_GAIN_1_4";
        zephyr,reference = "ADC_REF_INTERNAL";
        zephyr,vref-mv = <3894>;
        zephyr,acquisition-time = <ADC_ACQ_TIME_DEFAULT>;
        zephyr,resolution = <12>;
    };
};

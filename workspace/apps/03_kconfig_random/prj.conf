## CMakeLists.txt
```
cmake_minimum_required(VERSION 3.20.0)

# Must be set BEFORE find_package(Zephyr): Zephyr reads its module list (and each
# module's Kconfig) while find_package runs, so anything added later is never seen.
set(ZEPHYR_EXTRA_MODULES "${CMAKE_SOURCE_DIR}/../../modules/greeting")

find_package(Zephyr REQUIRED HINTS $ENV{ZEPHYR_BASE})
project(kconfig_random)

target_sources(app PRIVATE src/main.c)
```

## prj.conf
```kconfig
# App-level Kconfig: what this app needs on ANY board.
# (Board-specific choices, like the random source, live in boards/esp32s3_devkitc.conf.)

# Own module from workspace/modules/greeting (found via ZEPHYR_EXTRA_MODULES in CMakeLists.txt)
CONFIG_GREETING=y
# int, range 1..10 (defined in the module's Kconfig). Out-of-range values stop the build.
CONFIG_GREETING_REPEAT=3

# Float formatting for printk/printf ("%.3f"); without it, floats print as "*float*".
# With picolibc, printk is built on picolibc's vfprintf, so this also switches picolibc
# from PICOLIBC_IO_LONG_LONG (integer-only) to PICOLIBC_IO_FLOAT. Cost: +828 B of flash.
# CONFIG_FPU is not needed: it speeds up float *math*, it doesn't add *printing*.
CONFIG_CBPRINTF_FP_SUPPORT=y
```

## boards/esp32s3_devkitc.conf
```kconfig
# Board-specific Kconfig for esp32s3_devkitc (passed as EXTRA_CONF_FILE by scripts/build.sh)
# Merged after prj.conf, so it wins on conflicts.

# Random source: the ESP32-S3 hardware TRNG (devicetree trng0, status "okay").
# This one switch is all that's needed: ENTROPY_ESP32_RNG turns on by default and
# selects ENTROPY_HAS_DRIVER, so both random generator choices default to the hardware.
CONFIG_ENTROPY_GENERATOR=y

# Alternative used by the course demo: a fake, timer-based generator for testing only
# (prints a "not truly random" CMake warning). Only TEST_RANDOM_GENERATOR is actually
# chosen; the other three lines follow from it.
# CONFIG_TEST_RANDOM_GENERATOR=y
# CONFIG_TIMER_RANDOM_GENERATOR=y
# CONFIG_TEST_CSPRNG_GENERATOR=y
# CONFIG_STACK_POINTER_RANDOM=0

# Float printing is set in prj.conf (the app needs it on any board). CONFIG_FPU was measured
# and made no difference here: same image size, same compiler flags; the code uses double
# math, and the soft-float routines already live in the ESP32-S3 ROM.
```

## src/main.c
```c
/*
 * Lesson 3 — Kconfig
 *
 * Every second: print a random 32-bit number, 5 random bytes and the same number
 * as a float in [0, 1), then (if the greeting module is enabled) greet
 * CONFIG_GREETING_REPEAT times.
 *
 *   [x] 1. sys_rand32_get() / sys_rand_get(): link error until a random generator is
 *          enabled. Fixed with CONFIG_ENTROPY_GENERATOR=y (hardware TRNG) in
 *          boards/esp32s3_devkitc.conf
 *   [x] 2. Challenge: "%.3f" printed "*float*" until CONFIG_CBPRINTF_FP_SUPPORT=y
 *          (prj.conf). The FPU is NOT needed for printing; see lessons/03_kconfig/notes.md
 *   [x] 3. Own module (workspace/modules/greeting) with CONFIG_GREETING (bool) and
 *          CONFIG_GREETING_REPEAT (int, 1..10), enabled in prj.conf
 */
#include <zephyr/kernel.h>
#include <zephyr/random/random.h>

#ifdef CONFIG_GREETING
#include "greeting.h"
#endif

#define NUM_RANDOM_BYTES 5

int main(void)
{
	uint8_t buffer[NUM_RANDOM_BYTES];

	while (1) {
		/* One 32-bit value from the configured random generator */
		uint32_t rnd = sys_rand32_get();

		printk("Random u32:   %u\n", rnd);

		/* Fill a buffer with random bytes (same generator) */
		sys_rand_get(buffer, sizeof(buffer));

		printk("Random bytes:");
		for (int i = 0; i < NUM_RANDOM_BYTES; i++) {
			printk(" %3u", buffer[i]);
		}
		printk("\n");

		/*
		 * Scale to [0, 1): divide by 2^32 (not UINT32_MAX, which could give exactly 1.0).
		 * The double math runs in software (libgcc routines in the ESP32-S3 ROM);
		 * printing it needs CONFIG_CBPRINTF_FP_SUPPORT, otherwise "%.3f" prints "*float*".
		 */
		double f = (double)rnd / (UINT32_MAX + 1.0);

		printk("Random float: %.3f\n", f);

#ifdef CONFIG_GREETING
		greeting_say();
#endif
		k_msleep(1000);
	}

	return 0;
}
```

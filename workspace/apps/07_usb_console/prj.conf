## CMakeLists.txt
```
cmake_minimum_required(VERSION 3.20.0)

find_package(Zephyr REQUIRED HINTS $ENV{ZEPHYR_BASE})
project(usb_console)

FILE(GLOB app_sources src/*.c)
target_sources(app PRIVATE ${app_sources})
```

## prj.conf
```kconfig
# Lesson 7 challenge needs no Kconfig changes? Verify that claim yourself.
```

## boards/esp32s3_devkitc.overlay
```dts
/* Lesson 7 challenge: send printk() out of the native "USB" port instead of the "UART" port.
 * Hint (from the episode): look at the `chosen` node in
 *   /opt/toolchains/zephyr/boards/espressif/esp32s3_devkitc/esp32s3_devkitc_procpu.dts
 * Which node represents the native USB-Serial/JTAG peripheral? Point zephyr,console at it and enable it.
 * Keep the LED from lesson 1 so you can see it's running.
 */
/ {
	aliases {
		my-led = &led0;
	};

	leds {
		compatible = "gpio-leds";
		led0: d13 {
			gpios = <&gpio0 13 GPIO_ACTIVE_HIGH>;
		};
	};

	/* TODO: chosen { ... }; */
};

/* TODO: enable the USB serial node */
```

## src/main.c
```c
/*
 * Lesson 7 — same blink, but the console goes out of the USB port.
 * Flash via UART as usual, then: PORT=/dev/cu.usbmodemXXXX make monitor
 * Debug part: make openocd (Mac) + GDB in container (see .claude/skills/openocd-gdb-debug)
 * Goal: retype this from understanding, not copy. Every line should make sense to you.
 *
 * Extension TODOs (after it works):
 *   [ ] Blink "SOS" in Morse (... --- ...)
 *   [ ] Add a second LED in the overlay (pick a safe pin!) and alternate them
 *   [ ] Print k_uptime_get() each toggle — how accurate is k_msleep?
 */
#include <zephyr/kernel.h>
#include <zephyr/drivers/gpio.h>

static const int32_t sleep_time_ms = 1000;

/* Q: Where does DT_ALIAS(my_led) come from? (hint: boards/esp32s3_devkitc.overlay) */
static const struct gpio_dt_spec led = GPIO_DT_SPEC_GET(DT_ALIAS(my_led), gpios);

int main(void)
{
	int ret;
	int state = 0;

	if (!gpio_is_ready_dt(&led)) {
		printk("Error: LED GPIO not ready\r\n");
		return 0;
	}

	ret = gpio_pin_configure_dt(&led, GPIO_OUTPUT);
	if (ret < 0) {
		printk("Error %d: could not configure LED\r\n", ret);
		return 0;
	}

	while (1) {
		state = !state;
		printk("LED state: %d\r\n", state);

		ret = gpio_pin_set_dt(&led, state);
		if (ret < 0) {
			printk("Error %d: could not set LED\r\n", ret);
			return 0;
		}

		k_msleep(sleep_time_ms);
	}

	return 0;
}
```
